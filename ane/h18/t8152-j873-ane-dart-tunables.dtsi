// SPDX-License-Identifier: GPL-2.0+ OR MIT
/*
 * Apple T8152 (M6) J873: the ADT tunables of the ANE DART instances 1 to 3 (BRD, BRD, BWR), as (offset, mask, value) from
 * dart-tunables-instance-1..3 of /arm-io/dart-ane (24 byte records: u32 offset, u32 size 4, u64 mask, u64 value; 29, 29 and 28 records).
 * Use it after t8152-j873-ane-dart.dtsi. Instance 0 already carries its seven records there.
 *
 * Not in the default build on purpose. On the M2 the same words (0x20c, 0x220, 0x224, the 0x300 window and 16 per-stream words at 0x800) were
 * written live and 0x20c broke translation with the Linux page tables (receipts/2026-10-01-t6021-dart-tunables), while the reset values work.
 * The T8152 values of 0x20c are the same, 0x80000121; whether the Gen3 DART behaves the same is not known. Run it as its own boot.
 */

&dart_ane1 {
	apple,tunable = <0x20c 0x80000121 0x80000121>,
			<0x220 0x00000f0f 0x00000f0f>,
			<0x224 0x0000ffff 0x00000909>,
			<0x300 0x00001f31 0x00000001>,
			<0x308 0x3ffffffc 0x10000000>,
			<0x310 0x3ffffffc 0x3ffffffc>,
			<0x800 0x000f007f 0x00050000>,
			<0x804 0x000f007f 0x00050000>,
			<0x808 0x000f007f 0x00050020>,
			<0x80c 0x000f007f 0x00050020>,
			<0x810 0x000f007f 0x00010040>,
			<0x814 0x000f007f 0x00010040>,
			<0x818 0x000f007f 0x00010042>,
			<0x81c 0x000f007f 0x00010042>,
			<0x820 0x000f007f 0x00010042>,
			<0x824 0x000f007f 0x00010042>,
			<0x828 0x000f007f 0x00010042>,
			<0x82c 0x000f007f 0x00010042>,
			<0x830 0x000f007f 0x00010042>,
			<0x834 0x000f007f 0x00010042>,
			<0x838 0x000f007f 0x00010042>,
			<0x83c 0x000f007f 0x00010042>,
			<0x4600 0x00000002 0x00000002>,
			<0x4708 0x3ffffffc 0x104d8020>,
			<0x4718 0x3ffffffc 0x3a8ba840>,
			<0x4728 0x3ffffffc 0x1af34080>,
			<0x4738 0x3ffffffc 0x1985d100>,
			<0x4748 0x3ffffffc 0x3cefea00>,
			<0x4758 0x3ffffffc 0x02123400>;
};

&dart_ane2 {
	apple,tunable = <0x20c 0x80000121 0x80000121>,
			<0x220 0x00000f0f 0x00000f0f>,
			<0x224 0x0000ffff 0x00000909>,
			<0x300 0x00001f31 0x00000001>,
			<0x308 0x3ffffffc 0x10000000>,
			<0x310 0x3ffffffc 0x3ffffffc>,
			<0x800 0x000f007f 0x00050000>,
			<0x804 0x000f007f 0x00050000>,
			<0x808 0x000f007f 0x00050020>,
			<0x80c 0x000f007f 0x00050020>,
			<0x810 0x000f007f 0x00010040>,
			<0x814 0x000f007f 0x00010040>,
			<0x818 0x000f007f 0x00010042>,
			<0x81c 0x000f007f 0x00010042>,
			<0x820 0x000f007f 0x00010042>,
			<0x824 0x000f007f 0x00010042>,
			<0x828 0x000f007f 0x00010042>,
			<0x82c 0x000f007f 0x00010042>,
			<0x830 0x000f007f 0x00010042>,
			<0x834 0x000f007f 0x00010042>,
			<0x838 0x000f007f 0x00010042>,
			<0x83c 0x000f007f 0x00010042>,
			<0x4600 0x00000002 0x00000002>,
			<0x4708 0x3ffffffc 0x104d8020>,
			<0x4718 0x3ffffffc 0x3a8ba840>,
			<0x4728 0x3ffffffc 0x1af34080>,
			<0x4738 0x3ffffffc 0x1985d100>,
			<0x4748 0x3ffffffc 0x3cefea00>,
			<0x4758 0x3ffffffc 0x02123400>;
};

&dart_ane3 {
	apple,tunable = <0x20c 0x80000121 0x80000121>,
			<0x220 0x00000f0f 0x00000f0f>,
			<0x224 0x0000ffff 0x00000909>,
			<0x300 0x00001f31 0x00000001>,
			<0x308 0x3ffffffc 0x10000000>,
			<0x310 0x3ffffffc 0x3ffffffc>,
			<0x800 0x000f003f 0x00050000>,
			<0x804 0x000f003f 0x00050000>,
			<0x808 0x000f003f 0x00010020>,
			<0x80c 0x000f003f 0x00010020>,
			<0x810 0x000f003f 0x00010020>,
			<0x814 0x000f003f 0x00010020>,
			<0x818 0x000f003f 0x00010020>,
			<0x81c 0x000f003f 0x00010020>,
			<0x820 0x000f003f 0x00010020>,
			<0x824 0x000f003f 0x00010020>,
			<0x828 0x000f003f 0x00010020>,
			<0x82c 0x000f003f 0x00010020>,
			<0x830 0x000f003f 0x00010020>,
			<0x834 0x000f003f 0x00010020>,
			<0x838 0x000f003f 0x00010020>,
			<0x83c 0x000f003f 0x00010020>,
			<0x4600 0x00000002 0x00000002>,
			<0x4708 0x3ffffffc 0x104d8020>,
			<0x4718 0x3ffffffc 0x3a8ba840>,
			<0x4728 0x3ffffffc 0x1af34080>,
			<0x4738 0x3ffffffc 0x1985d100>,
			<0x4748 0x3ffffffc 0x3cefea00>;
};
